SECTIONS
{
    __romPos = 0;
    header_ROM_START = __romPos;
    header_VRAM = ADDR(.header);
    .header : AT(header_ROM_START) SUBALIGN(16)
    {
        FILL(0x00000000);
        header_DATA_START = .;
        build/us/asm/us/header.o(.data);
        header_DATA_END = .;
        header_DATA_SIZE = ABSOLUTE(header_DATA_END - header_DATA_START);
    }
    __romPos += SIZEOF(.header);
    header_ROM_END = __romPos;
    header_VRAM_END = .;

    ipl3_ROM_START = __romPos;
    ipl3_VRAM = ADDR(.ipl3);
    .ipl3 : AT(ipl3_ROM_START) SUBALIGN(16)
    {
        FILL(0x00000000);
        ipl3_DATA_START = .;
        build/us/assets/us/ipl3.o(.data);
        ipl3_DATA_END = .;
        ipl3_DATA_SIZE = ABSOLUTE(ipl3_DATA_END - ipl3_DATA_START);
    }
    __romPos += SIZEOF(.ipl3);
    ipl3_ROM_END = __romPos;
    ipl3_VRAM_END = .;

    entry_ROM_START = __romPos;
    entry_VRAM = ADDR(.entry);
    .entry 0x80000400 : AT(entry_ROM_START) SUBALIGN(16)
    {
        FILL(0x00000000);
        entry_TEXT_START = .;
        build/us/asm/us/1000.o(.text);
        . = ALIGN(., 16);
        entry_TEXT_END = .;
        entry_TEXT_SIZE = ABSOLUTE(entry_TEXT_END - entry_TEXT_START);
        entry_DATA_START = .;
        build/us/asm/us/1000.o(.data);
        . = ALIGN(., 16);
        entry_DATA_END = .;
        entry_DATA_SIZE = ABSOLUTE(entry_DATA_END - entry_DATA_START);
        entry_RODATA_START = .;
        build/us/asm/us/1000.o(.rodata);
        . = ALIGN(., 16);
        entry_RODATA_END = .;
        entry_RODATA_SIZE = ABSOLUTE(entry_RODATA_END - entry_RODATA_START);
    }
    entry_bss_VRAM = ADDR(.entry_bss);
    .entry_bss (NOLOAD) : SUBALIGN(16)
    {
        FILL(0x00000000);
        entry_BSS_START = .;
        build/us/asm/us/1000.o(.bss);
        . = ALIGN(., 16);
        entry_BSS_END = .;
        entry_BSS_SIZE = ABSOLUTE(entry_BSS_END - entry_BSS_START);
    }
    __romPos += SIZEOF(.entry);
    __romPos = ALIGN(__romPos, 16);
    . = ALIGN(., 16);
    entry_ROM_END = __romPos;
    entry_VRAM_END = .;

    main_ROM_START = __romPos;
    main_VRAM = ADDR(.main);
    .main entry_VRAM_END : AT(main_ROM_START) SUBALIGN(16)
    {
        FILL(0x00000000);
        main_TEXT_START = .;
        build/us/src/rom/lib_1050_sdk.o(.text);
        build/us/src/rom/lib_1050.o(.text);
        build/us/src/rom/lib_21f0.o(.text);
        build/us/src/rom/lib_2cf0.o(.text);
        build/us/src/rom/lib_3140.o(.text);
        build/us/src/rom/lib_3330.o(.text);
        build/us/src/rom/lib_3390.o(.text);
        build/us/src/rom/lib_34a0.o(.text);
        build/us/asm/us/55F0.o(.text);
        build/us/src/rom/lib_5610.o(.text);
        build/us/src/rom/lib_7600.o(.text);
        build/us/src/rom/lib_7630.o(.text);
        build/us/src/rom/lib_7940.o(.text);
        build/us/src/rom/lib_79a0.o(.text);
        build/us/src/rom/lib_7a10.o(.text);
        build/us/src/rom/lib_7ad0.o(.text);
        build/us/src/rom/lib_7b30.o(.text);
        build/us/src/rom/lib_7c80.o(.text);
        build/us/src/rom/lib_7fb0.o(.text);
        build/us/src/rom/lib_8040_msg.o(.text);
        build/us/src/rom/lib_8040.o(.text);
        build/us/src/rom/lib_81e0.o(.text);
        build/us/src/rom/lib_8330.o(.text);
        build/us/src/rom/lib_83d0.o(.text);
        build/us/asm/us/8410.o(.text);
        build/us/src/rom/lib_8440.o(.text);
        /* ROM_TEXT_BOUNDARY_BEGIN build/us/src/rom/lib_8700.o(.text) */
        rom_text_lib_8700_START = .;
        build/us/src/rom/lib_8700.o(.text);
        rom_text_lib_8700_INPUT_END = .;
        ASSERT(ABSOLUTE(rom_text_lib_8700_START) == 0x80007b00, "original text owner moved");
        ASSERT(rom_text_lib_8700_INPUT_END == rom_text_lib_8700_START + 0xa0 || rom_text_lib_8700_INPUT_END == rom_text_lib_8700_START + 0x100, "unproven text owner extent");
        ASSERT(ABSOLUTE(osDpSetNextBuffer) == 0x80007b00, "original text alias moved");
        ASSERT(ABSOLUTE(osDpWait) == 0x80007b80, "original text alias moved");
        ASSERT(ABSOLUTE(strchr) == 0x80007c00, "original text alias moved");
        FILL(0x00000000);
        . = rom_text_lib_8700_START + 0x100;
        rom_text_lib_8700_END = .;
        /* ROM_TEXT_BOUNDARY_END build/us/src/rom/lib_8700.o(.text) */
        build/us/src/rom/lib_8800.o(.text);
        build/us/asm/us/88A0.o(.text);
        build/us/src/rom/lib_8920.o(.text);
        build/us/src/rom/lib_8a80.o(.text);
        build/us/src/rom/lib_8dd0.o(.text);
        build/us/src/rom/lib_8e10_pi.o(.text);
        build/us/src/rom/lib_8e10.o(.text);
        build/us/asm/us/90E0.o(.text);
        build/us/asm/us/9190.o(.text);
        build/us/src/rom/lib_9230.o(.text);
        build/us/src/rom/lib_92f0.o(.text);
        build/us/src/rom/lib_9330.o(.text);
        build/us/src/rom/lib_9660.o(.text);
        build/us/src/rom/lib_9820.o(.text);
        build/us/src/rom/lib_9ab0.o(.text);
        build/us/src/rom/lib_9de0.o(.text);
        build/us/src/rom/lib_a050.o(.text);
        build/us/src/rom/lib_a330.o(.text);
        build/us/src/rom/lib_a5b0.o(.text);
        build/us/asm/us/A5F0.o(.text);
        build/us/src/rom/lib_a800.o(.text);
        build/us/src/rom/lib_a810.o(.text);
        build/us/src/rom/lib_ab20.o(.text);
        build/us/src/rom/lib_af50.o(.text);
        build/us/src/rom/lib_b120.o(.text);
        build/us/src/rom/lib_b300.o(.text);
        build/us/src/rom/lib_b570.o(.text);
        build/us/src/rom/lib_b9f0.o(.text);
        build/us/src/rom/lib_be40.o(.text);
        build/us/src/rom/lib_bfe0.o(.text);
        build/us/src/rom/lib_c990.o(.text);
        build/us/src/rom/lib_ca70.o(.text);
        build/us/src/rom/lib_cc50.o(.text);
        build/us/asm/us/D0B0.o(.text);
        build/us/src/rom/lib_d140.o(.text);
        build/us/src/rom/lib_d260.o(.text);
        build/us/src/rom/lib_d270.o(.text);
        build/us/asm/us/D570.o(.text);
        build/us/src/rom/lib_d580.o(.text);
        build/us/asm/us/DEB0.o(.text);
        build/us/src/rom/lib_e1c0.o(.text);
        build/us/src/rom/lib_e240.o(.text);
        build/us/src/rom/lib_e250.o(.text);
        build/us/src/rom/lib_e280.o(.text);
        build/us/src/rom/lib_e310.o(.text);
        build/us/src/rom/lib_e340.o(.text);
        build/us/asm/us/E370.o(.text);
        build/us/src/rom/lib_e390.o(.text);
        build/us/src/rom/lib_e3f0.o(.text);
        build/us/asm/us/E440.o(.text);
        build/us/asm/us/E490.o(.text);
        build/us/asm/us/E4F0.o(.text);
        build/us/src/rom/lib_e7c0.o(.text);
        build/us/src/rom/lib_e8d0.o(.text);
        build/us/src/rom/lib_e9a0.o(.text);
        build/us/asm/us/EFC0.o(.text);
        build/us/src/rom/lib_efd0.o(.text);
        build/us/src/rom/lib_f0b0.o(.text);
        build/us/src/rom/lib_f160.o(.text);
        build/us/src/rom/lib_f450.o(.text);
        build/us/src/rom/lib_f4d0.o(.text);
        build/us/src/rom/lib_f700.o(.text);
        . = ALIGN(., 16);
        main_TEXT_END = .;
        main_TEXT_SIZE = ABSOLUTE(main_TEXT_END - main_TEXT_START);
        main_DATA_START = .;
        build/us/src/rom/lib_1050_sdk.o(.data);
        build/us/src/rom/lib_1050.o(.data);
        build/us/src/rom/lib_21f0.o(.data);
        build/us/src/rom/lib_2cf0.o(.data);
        build/us/src/rom/lib_3140.o(.data);
        build/us/src/rom/lib_3330.o(.data);
        build/us/src/rom/lib_3390.o(.data);
        build/us/src/rom/lib_34a0.o(.data);
        build/us/asm/us/55F0.o(.data);
        build/us/src/rom/lib_5610.o(.data);
        build/us/src/rom/lib_7600.o(.data);
        build/us/src/rom/lib_7630.o(.data);
        build/us/src/rom/lib_7940.o(.data);
        build/us/src/rom/lib_79a0.o(.data);
        build/us/src/rom/lib_7a10.o(.data);
        build/us/src/rom/lib_7ad0.o(.data);
        build/us/src/rom/lib_7b30.o(.data);
        build/us/src/rom/lib_7c80.o(.data);
        build/us/src/rom/lib_7fb0.o(.data);
        build/us/src/rom/lib_8040_msg.o(.data);
        build/us/src/rom/lib_8040.o(.data);
        build/us/src/rom/lib_81e0.o(.data);
        build/us/src/rom/lib_8330.o(.data);
        build/us/src/rom/lib_83d0.o(.data);
        build/us/asm/us/8410.o(.data);
        build/us/src/rom/lib_8440.o(.data);
        build/us/src/rom/lib_8700.o(.data);
        build/us/src/rom/lib_8800.o(.data);
        build/us/asm/us/88A0.o(.data);
        build/us/src/rom/lib_8920.o(.data);
        /* ROM_OWNED_SECTION_MOVED build/us/src/rom/lib_8a80.o(.data) */
        build/us/src/rom/lib_8dd0.o(.data);
        build/us/src/rom/lib_8e10_pi.o(.data);
        build/us/src/rom/lib_8e10.o(.data);
        build/us/asm/us/90E0.o(.data);
        build/us/asm/us/9190.o(.data);
        build/us/src/rom/lib_9230.o(.data);
        build/us/src/rom/lib_92f0.o(.data);
        build/us/src/rom/lib_9330.o(.data);
        build/us/src/rom/lib_9660.o(.data);
        build/us/src/rom/lib_9820.o(.data);
        build/us/src/rom/lib_9ab0.o(.data);
        build/us/src/rom/lib_9de0.o(.data);
        build/us/src/rom/lib_a050.o(.data);
        build/us/src/rom/lib_a330.o(.data);
        build/us/src/rom/lib_a5b0.o(.data);
        build/us/asm/us/A5F0.o(.data);
        build/us/src/rom/lib_a800.o(.data);
        build/us/src/rom/lib_a810.o(.data);
        build/us/src/rom/lib_ab20.o(.data);
        build/us/src/rom/lib_af50.o(.data);
        build/us/src/rom/lib_b120.o(.data);
        build/us/src/rom/lib_b300.o(.data);
        build/us/src/rom/lib_b570.o(.data);
        build/us/src/rom/lib_b9f0.o(.data);
        build/us/src/rom/lib_be40.o(.data);
        build/us/src/rom/lib_bfe0.o(.data);
        build/us/src/rom/lib_c990.o(.data);
        build/us/src/rom/lib_ca70.o(.data);
        /* ROM_OWNED_SECTION_MOVED build/us/src/rom/lib_cc50.o(.data) */
        build/us/asm/us/D0B0.o(.data);
        build/us/src/rom/lib_d140.o(.data);
        build/us/src/rom/lib_d260.o(.data);
        build/us/src/rom/lib_d270.o(.data);
        build/us/asm/us/D570.o(.data);
        build/us/src/rom/lib_d580.o(.data);
        build/us/asm/us/DEB0.o(.data);
        build/us/src/rom/lib_e1c0.o(.data);
        build/us/src/rom/lib_e240.o(.data);
        build/us/src/rom/lib_e250.o(.data);
        build/us/src/rom/lib_e280.o(.data);
        build/us/src/rom/lib_e310.o(.data);
        build/us/src/rom/lib_e340.o(.data);
        build/us/asm/us/E370.o(.data);
        build/us/src/rom/lib_e390.o(.data);
        build/us/src/rom/lib_e3f0.o(.data);
        build/us/asm/us/E440.o(.data);
        build/us/asm/us/E490.o(.data);
        build/us/asm/us/E4F0.o(.data);
        build/us/src/rom/lib_e7c0.o(.data);
        build/us/src/rom/lib_e8d0.o(.data);
        build/us/src/rom/lib_e9a0.o(.data);
        build/us/asm/us/EFC0.o(.data);
        build/us/src/rom/lib_efd0.o(.data);
        build/us/src/rom/lib_f0b0.o(.data);
        build/us/src/rom/lib_f160.o(.data);
        build/us/src/rom/lib_f450.o(.data);
        build/us/src/rom/lib_f4d0.o(.data);
        build/us/src/rom/lib_f700.o(.data);
        . = ALIGN(., 16);
        main_DATA_END = .;
        main_DATA_SIZE = ABSOLUTE(main_DATA_END - main_DATA_START);
        main_RODATA_START = .;
        /* ROM_OWNED_SECTION_MOVED build/us/src/rom/lib_1050_sdk.o(.rodata) */
        build/us/src/rom/lib_1050.o(.rodata);
        build/us/src/rom/lib_21f0.o(.rodata);
        build/us/src/rom/lib_2cf0.o(.rodata);
        build/us/src/rom/lib_3140.o(.rodata);
        build/us/src/rom/lib_3330.o(.rodata);
        build/us/src/rom/lib_3390.o(.rodata);
        /* ROM_OWNED_SECTION_MOVED build/us/src/rom/lib_34a0.o(.rodata) */
        build/us/asm/us/55F0.o(.rodata);
        build/us/src/rom/lib_5610.o(.rodata);
        build/us/src/rom/lib_7600.o(.rodata);
        build/us/src/rom/lib_7630.o(.rodata);
        build/us/src/rom/lib_7940.o(.rodata);
        build/us/src/rom/lib_79a0.o(.rodata);
        build/us/src/rom/lib_7a10.o(.rodata);
        build/us/src/rom/lib_7ad0.o(.rodata);
        build/us/src/rom/lib_7b30.o(.rodata);
        build/us/src/rom/lib_7c80.o(.rodata);
        build/us/src/rom/lib_7fb0.o(.rodata);
        build/us/src/rom/lib_8040_msg.o(.rodata);
        build/us/src/rom/lib_8040.o(.rodata);
        build/us/src/rom/lib_81e0.o(.rodata);
        build/us/src/rom/lib_8330.o(.rodata);
        build/us/src/rom/lib_83d0.o(.rodata);
        build/us/asm/us/8410.o(.rodata);
        build/us/src/rom/lib_8440.o(.rodata);
        build/us/src/rom/lib_8700.o(.rodata);
        build/us/src/rom/lib_8800.o(.rodata);
        build/us/asm/us/88A0.o(.rodata);
        build/us/src/rom/lib_8920.o(.rodata);
        build/us/src/rom/lib_8a80.o(.rodata);
        build/us/src/rom/lib_8dd0.o(.rodata);
        build/us/src/rom/lib_8e10_pi.o(.rodata);
        build/us/src/rom/lib_8e10.o(.rodata);
        build/us/asm/us/90E0.o(.rodata);
        build/us/asm/us/9190.o(.rodata);
        build/us/src/rom/lib_9230.o(.rodata);
        build/us/src/rom/lib_92f0.o(.rodata);
        build/us/src/rom/lib_9330.o(.rodata);
        build/us/src/rom/lib_9660.o(.rodata);
        build/us/src/rom/lib_9820.o(.rodata);
        build/us/src/rom/lib_9ab0.o(.rodata);
        build/us/src/rom/lib_9de0.o(.rodata);
        build/us/src/rom/lib_a050.o(.rodata);
        build/us/src/rom/lib_a330.o(.rodata);
        build/us/src/rom/lib_a5b0.o(.rodata);
        build/us/asm/us/A5F0.o(.rodata);
        build/us/src/rom/lib_a800.o(.rodata);
        build/us/src/rom/lib_a810.o(.rodata);
        build/us/src/rom/lib_ab20.o(.rodata);
        build/us/src/rom/lib_af50.o(.rodata);
        build/us/src/rom/lib_b120.o(.rodata);
        build/us/src/rom/lib_b300.o(.rodata);
        build/us/src/rom/lib_b570.o(.rodata);
        build/us/src/rom/lib_b9f0.o(.rodata);
        build/us/src/rom/lib_be40.o(.rodata);
        build/us/src/rom/lib_bfe0.o(.rodata);
        build/us/src/rom/lib_c990.o(.rodata);
        build/us/src/rom/lib_ca70.o(.rodata);
        build/us/src/rom/lib_cc50.o(.rodata);
        build/us/asm/us/D0B0.o(.rodata);
        build/us/src/rom/lib_d140.o(.rodata);
        build/us/src/rom/lib_d260.o(.rodata);
        build/us/src/rom/lib_d270.o(.rodata);
        build/us/asm/us/D570.o(.rodata);
        build/us/src/rom/lib_d580.o(.rodata);
        build/us/asm/us/DEB0.o(.rodata);
        build/us/src/rom/lib_e1c0.o(.rodata);
        build/us/src/rom/lib_e240.o(.rodata);
        build/us/src/rom/lib_e250.o(.rodata);
        build/us/src/rom/lib_e280.o(.rodata);
        build/us/src/rom/lib_e310.o(.rodata);
        build/us/src/rom/lib_e340.o(.rodata);
        build/us/asm/us/E370.o(.rodata);
        build/us/src/rom/lib_e390.o(.rodata);
        build/us/src/rom/lib_e3f0.o(.rodata);
        build/us/asm/us/E440.o(.rodata);
        build/us/asm/us/E490.o(.rodata);
        build/us/asm/us/E4F0.o(.rodata);
        build/us/src/rom/lib_e7c0.o(.rodata);
        build/us/src/rom/lib_e8d0.o(.rodata);
        /* ROM_OWNED_SECTION_MOVED build/us/src/rom/lib_e9a0.o(.rodata) */
        build/us/asm/us/EFC0.o(.rodata);
        build/us/src/rom/lib_efd0.o(.rodata);
        build/us/src/rom/lib_f0b0.o(.rodata);
        build/us/src/rom/lib_f160.o(.rodata);
        build/us/src/rom/lib_f450.o(.rodata);
        build/us/src/rom/lib_f4d0.o(.rodata);
        build/us/src/rom/lib_f700.o(.rodata);
        . = ALIGN(., 16);
        main_RODATA_END = .;
        main_RODATA_SIZE = ABSOLUTE(main_RODATA_END - main_RODATA_START);
    }
    main_bss_VRAM = ADDR(.main_bss);
    .main_bss (NOLOAD) : SUBALIGN(16)
    {
        FILL(0x00000000);
        main_BSS_START = .;
        build/us/src/rom/lib_1050_sdk.o(.bss);
        build/us/src/rom/lib_1050.o(.bss);
        build/us/src/rom/lib_21f0.o(.bss);
        build/us/src/rom/lib_2cf0.o(.bss);
        build/us/src/rom/lib_3140.o(.bss);
        build/us/src/rom/lib_3330.o(.bss);
        build/us/src/rom/lib_3390.o(.bss);
        build/us/src/rom/lib_34a0.o(.bss);
        build/us/asm/us/55F0.o(.bss);
        build/us/src/rom/lib_5610.o(.bss);
        build/us/src/rom/lib_7600.o(.bss);
        build/us/src/rom/lib_7630.o(.bss);
        build/us/src/rom/lib_7940.o(.bss);
        build/us/src/rom/lib_79a0.o(.bss);
        build/us/src/rom/lib_7a10.o(.bss);
        build/us/src/rom/lib_7ad0.o(.bss);
        build/us/src/rom/lib_7b30.o(.bss);
        build/us/src/rom/lib_7c80.o(.bss);
        build/us/src/rom/lib_7fb0.o(.bss);
        build/us/src/rom/lib_8040_msg.o(.bss);
        build/us/src/rom/lib_8040.o(.bss);
        build/us/src/rom/lib_81e0.o(.bss);
        build/us/src/rom/lib_8330.o(.bss);
        build/us/src/rom/lib_83d0.o(.bss);
        build/us/asm/us/8410.o(.bss);
        build/us/src/rom/lib_8440.o(.bss);
        build/us/src/rom/lib_8700.o(.bss);
        build/us/src/rom/lib_8800.o(.bss);
        build/us/asm/us/88A0.o(.bss);
        build/us/src/rom/lib_8920.o(.bss);
        build/us/src/rom/lib_8a80.o(.bss);
        build/us/src/rom/lib_8dd0.o(.bss);
        build/us/src/rom/lib_8e10_pi.o(.bss);
        build/us/src/rom/lib_8e10.o(.bss);
        build/us/asm/us/90E0.o(.bss);
        build/us/asm/us/9190.o(.bss);
        build/us/src/rom/lib_9230.o(.bss);
        build/us/src/rom/lib_92f0.o(.bss);
        build/us/src/rom/lib_9330.o(.bss);
        build/us/src/rom/lib_9660.o(.bss);
        build/us/src/rom/lib_9820.o(.bss);
        build/us/src/rom/lib_9ab0.o(.bss);
        build/us/src/rom/lib_9de0.o(.bss);
        build/us/src/rom/lib_a050.o(.bss);
        build/us/src/rom/lib_a330.o(.bss);
        build/us/src/rom/lib_a5b0.o(.bss);
        build/us/asm/us/A5F0.o(.bss);
        build/us/src/rom/lib_a800.o(.bss);
        build/us/src/rom/lib_a810.o(.bss);
        build/us/src/rom/lib_ab20.o(.bss);
        build/us/src/rom/lib_af50.o(.bss);
        build/us/src/rom/lib_b120.o(.bss);
        build/us/src/rom/lib_b300.o(.bss);
        build/us/src/rom/lib_b570.o(.bss);
        build/us/src/rom/lib_b9f0.o(.bss);
        build/us/src/rom/lib_be40.o(.bss);
        build/us/src/rom/lib_bfe0.o(.bss);
        build/us/src/rom/lib_c990.o(.bss);
        build/us/src/rom/lib_ca70.o(.bss);
        build/us/src/rom/lib_cc50.o(.bss);
        build/us/asm/us/D0B0.o(.bss);
        build/us/src/rom/lib_d140.o(.bss);
        build/us/src/rom/lib_d260.o(.bss);
        build/us/src/rom/lib_d270.o(.bss);
        build/us/asm/us/D570.o(.bss);
        build/us/src/rom/lib_d580.o(.bss);
        build/us/asm/us/DEB0.o(.bss);
        build/us/src/rom/lib_e1c0.o(.bss);
        build/us/src/rom/lib_e240.o(.bss);
        build/us/src/rom/lib_e250.o(.bss);
        build/us/src/rom/lib_e280.o(.bss);
        build/us/src/rom/lib_e310.o(.bss);
        build/us/src/rom/lib_e340.o(.bss);
        build/us/asm/us/E370.o(.bss);
        build/us/src/rom/lib_e390.o(.bss);
        build/us/src/rom/lib_e3f0.o(.bss);
        build/us/asm/us/E440.o(.bss);
        build/us/asm/us/E490.o(.bss);
        build/us/asm/us/E4F0.o(.bss);
        build/us/src/rom/lib_e7c0.o(.bss);
        build/us/src/rom/lib_e8d0.o(.bss);
        build/us/src/rom/lib_e9a0.o(.bss);
        build/us/asm/us/EFC0.o(.bss);
        build/us/src/rom/lib_efd0.o(.bss);
        build/us/src/rom/lib_f0b0.o(.bss);
        build/us/src/rom/lib_f160.o(.bss);
        build/us/src/rom/lib_f450.o(.bss);
        build/us/src/rom/lib_f4d0.o(.bss);
        build/us/src/rom/lib_f700.o(.bss);
        . = ALIGN(., 16);
        main_BSS_END = .;
        main_BSS_SIZE = ABSOLUTE(main_BSS_END - main_BSS_START);
    }
    __romPos += SIZEOF(.main);
    __romPos = ALIGN(__romPos, 16);
    . = ALIGN(., 16);
    main_ROM_END = __romPos;
    main_VRAM_END = .;

    data_ROM_START = __romPos;
    data_VRAM = ADDR(.data);
    .data : AT(data_ROM_START) /* ROM_OWNED_SUBALIGN SUBALIGN(16) */
    {
        FILL(0x00000000);
        data_DATA_START = .;
        /* ROM_OWNED_DATA_BEGIN build/us/assets/us/data.o(.data) */
        _binary_assets_us_data_bin_start = ABSOLUTE(.);
        _binary_build_us_assets_us_data_composed_bin_start = ABSOLUTE(.);
        build/us/assets/us/data.o(.data.owned0);
        rom_owned_sdk_initialize_data_START = ABSOLUTE(.);
        build/us/src/rom/lib_8a80.o(.data);
        rom_owned_sdk_initialize_data_END = ABSOLUTE(.);
        ASSERT(rom_owned_sdk_initialize_data_START == 0x8002c360, "owned ROM slot address changed");
        ASSERT(rom_owned_sdk_initialize_data_END - rom_owned_sdk_initialize_data_START == 0x20, "owned ROM slot size changed");
        build/us/assets/us/data.o(.data.owned1);
        rom_owned_timer_services_pointer_START = ABSOLUTE(.);
        build/us/src/rom/lib_cc50.o(.data);
        rom_owned_timer_services_pointer_END = ABSOLUTE(.);
        ASSERT(rom_owned_timer_services_pointer_START == 0x8002c3f0, "owned ROM slot address changed");
        ASSERT(rom_owned_timer_services_pointer_END - rom_owned_timer_services_pointer_START == 0x10, "owned ROM slot size changed");
        build/us/assets/us/data.o(.data.owned2);
        rom_owned___scScheduleCore_START = ABSOLUTE(.);
        build/us/src/rom/lib_1050_sdk.o(.rodata);
        rom_owned___scScheduleCore_END = ABSOLUTE(.);
        ASSERT(rom_owned___scScheduleCore_START == 0x8002d4a4, "owned ROM slot address changed");
        ASSERT(rom_owned___scScheduleCore_END - rom_owned___scScheduleCore_START == 0x1c, "owned ROM slot size changed");
        ASSERT(rom_owned___scScheduleCore_START % 4 == 0, "owned table alignment changed");
        build/us/assets/us/data.o(.data.owned3);
        rom_owned_fcvt_START = ABSOLUTE(.);
        build/us/src/rom/lib_34a0.o(.rodata);
        rom_owned_fcvt_END = ABSOLUTE(.);
        ASSERT(rom_owned_fcvt_START == 0x8002d558, "owned ROM slot address changed");
        ASSERT(rom_owned_fcvt_END - rom_owned_fcvt_START == 0x164, "owned ROM slot size changed");
        ASSERT(rom_owned_fcvt_START % 4 == 0, "owned table alignment changed");
        build/us/assets/us/data.o(.data.owned4);
        rom_owned_osSpTaskLoad_full_START = ABSOLUTE(.);
        build/us/src/rom/lib_e9a0.o(.rodata);
        rom_owned_osSpTaskLoad_full_END = ABSOLUTE(.);
        ASSERT(rom_owned_osSpTaskLoad_full_START == 0x8002d860, "owned ROM slot address changed");
        ASSERT(rom_owned_osSpTaskLoad_full_END - rom_owned_osSpTaskLoad_full_START == 0x20, "owned ROM slot size changed");
        build/us/assets/us/data.o(.data.owned5);
        _binary_assets_us_data_bin_end = ABSOLUTE(.);
        _binary_assets_us_data_bin_size = ABSOLUTE(_binary_assets_us_data_bin_end - _binary_assets_us_data_bin_start);
        _binary_build_us_assets_us_data_composed_bin_end = ABSOLUTE(.);
        _binary_build_us_assets_us_data_composed_bin_size = ABSOLUTE(_binary_build_us_assets_us_data_composed_bin_end - _binary_build_us_assets_us_data_composed_bin_start);
        /* ROM_OWNED_DATA_END build/us/assets/us/data.o(.data) */
        data_DATA_END = .;
        data_DATA_SIZE = ABSOLUTE(data_DATA_END - data_DATA_START);
    }
    __romPos += SIZEOF(.data);
    data_ROM_END = __romPos;
    data_VRAM_END = .;

    /DISCARD/ :
    {
        *(*);
    }
}
